## main/Kconfig.projbuild
```kconfig
menu "X Speaker Configuration"
    config SPEAKER_DEVICE_NAME
        string "Local Device Name"
        default "X_SPEAKER"
        help
            Use this option to set local device name.


# "I2S pin configuration"
    config I2S_BCK_PIN
        int "I2S BCK pin GPIO Number"
        default 26
        help
            Use this option to set I2S BCK pin number.

    config I2S_LRCK_PIN
        int "I2S LRCK pin GPIO Number"
        default 27
        help
            Use this option to set I2S LRCK pin number.

    config I2S_DATA_PIN
        int "I2S DATA pin GPIO Number"
        default 25
        help
            Use this option to set I2S DATA pin number.


# "LCD configuration"
    config LCD_HOST
        int "LCD SPI Host"
        default 2
        help
            LCD SPI host selection e.g. SPI1_HOST (0) or SPI2_HOST (2)

    config LCD_V_RES
        int "LCD Vertical Resolution"
        default 320
        help
            LCD vertical pixel count.

    config LCD_H_RES
        int "LCD Horizontal Resolution"
        default 240
        help
            LCD horizontal pixel count.

    config LCD_PIXEL_CLOCK_HZ
        int "LCD Pixel Clock Hz"
        default 40000000
        help
            LCD pixel clock frequency in Hz.

    config BITS_PER_PIXEL
        int "LCD Bits Per Pixel"
        default 16
        help
            LCD color depth.

    config LCD_CS
        int "LCD Chip Select GPIO"
        default 18
        help
            LCD chip select pin GPIO number.

    config LCD_DC
        int "LCD Data/Command GPIO"
        default 4
        help
            LCD data/command pin GPIO number.

    config LCD_RST
        int "LCD Reset GPIO"
        default 16
        help
            LCD reset pin GPIO number.

    config LCD_MOSI
        int "LCD MOSI GPIO"
        default 5
        help
            LCD MOSI pin.

    config LCD_CLK
        int "LCD CLK GPIO"
        default 17
        help
            LCD clock pin.


# "Touch panel configuration"
    config TOUCH_I2C_SCL
        int "Touch I2C SCL GPIO"
        default 21
        help
            Touch panel I2C SCL pin GPIO number.

    config TOUCH_I2C_SDA
        int "Touch I2C SDA GPIO"
        default 19
        help
            Touch panel I2C SDA pin GPIO number.

    config TOUCH_GPIO_INT
        int "Touch GPIO INT"
        default 22
        help
            Touch panel interrupt pin.
    config TOUCH_GPIO_RESET
        int "Touch GPIO RESET"
        default 23
        help
            Touch panel reset pin.
    config TOUCH_I2C_NUM
        int "Touch I2C Port"
        default 0
        help
            Touch panel I2C controller number.

    config TOUCH_I2C_CLK_HZ
        int "Touch I2C Clock Hz"
        default 100000
        help
            Touch panel I2C speed.

    config LCD_CMD_BITS
        int "LCD Command bits"
        default 8
        help
            Bits used for command in SPI transactions.

    config LCD_PARAM_BITS
        int "LCD Parameter bits"
        default 8
        help
            Bits used for parameter in SPI transactions.

# "LVGL configuration"
    config LVGL_DRAW_BUF_LINES
        int "LVGL Draw Buffer Lines"
        default 20
        help
            Number of display lines in each LVGL draw buffer.

    config LVGL_TICK_PERIOD_MS
        int "LVGL Tick Period (ms)"
        default 2
        help
            LVGL tick period in milliseconds.

    config LVGL_TASK_MAX_DELAY_MS
        int "LVGL Task Max Delay (ms)"
        default 500
        help
            LVGL task maximum delay in milliseconds.

    config LVGL_TASK_MIN_DELAY_MS
        int "LVGL Task Min Delay (ms)"
        default 0
        help
            LVGL task minimum delay (ms). Usually computed from CONFIG_FREERTOS_HZ.

    config LVGL_TASK_STACK_SIZE
        int "LVGL Task Stack Size"
        default 8192
        help
            LVGL task stack size in bytes.

    config LVGL_TASK_PRIORITY
        int "LVGL Task Priority"
        default 5
        help
            LVGL task priority.
endmenu
```
